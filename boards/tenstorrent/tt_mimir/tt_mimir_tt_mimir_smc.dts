/*
 * Copyright (c) 2024 Tenstorrent AI ULC
 *
 * SPDX-License-Identifier: Apache-2.0
 */

/dts-v1/;

#include <tenstorrent/tt_grendel_smc.dtsi>

/ {
	chosen {
		zephyr,sram = &ram0;
	};

	msgqueue_mbox: msgqueue_mbox {
		compatible = "tenstorrent,msgqueue-mbox";
		mboxes = <&mbox0 1>;
		mbox-names = "doorbell";
		status = "okay";
	};
};
